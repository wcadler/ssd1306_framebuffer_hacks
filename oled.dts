// Definitions for Rpi-Proto
/dts-v1/;
/plugin/;

/ {
	compatible = "brcm,bcm2835", "brcm,bcm2708", "brcm,bcm2709";

	fragment@0 {
		target = <&i2c>;
		__overlay__ {
			status = "okay";
			#address-cells = <1>;
			#size-cells = <0>;			
			ssd1306: oled@3c {
				compatible = "solomon,ssd1306fb-i2c";
				reg = <0x3c>;
				solomon,width = <128>;
				solomon,height = <64>;
				solomon,page-offset = <0>;
			};
		};
	};
};
